/*  Sistemi Corporation, copyright, all rights reserved, 2023-2026
 *  Martin Guthrie
 *
 *  MAX11311 IOX (IO Expander), see bond_max_iox.h
 */
#include "bond_max_iox.h"
#include "bond_pins.h"
#include "rpc_helpers.h"
#include "src/oled/bond_oled.h"

#define MAX11311_DEV_ID  0x424  // see datasheet
#define IOX_DAC_FULL_MV  10000  // DAC ports are 0 to +10V
#define LDO_VFB_MV       550
#define LDO_R46_OHMS     16000
#define LDO_R47_OHMS     5100

MAX11300 max_iox = MAX11300();

typedef struct {
  MAX11300RegAddress_t r;
  uint16_t d;
} _init_regs_t;

// default IOX MAX11311 registers, set on init
// this array is pulled from init code auto generated by
// MAX11300/01/11/12 Configuration Software (Ver. 1.1.0.5) 16/10/2025 17:41
// The file src/MAX11311/a4402-MAX11300Design_iox_01.mpix is the source file for the tool.
static const _init_regs_t init_regs[] = {
  {.r = device_control, .d = 0x8000}, // reset
  {.r = device_control, .d = 0xc0 & 0x40b0},
  {.r = device_control, .d = 0xc0 & 0x40fc},
  {.r = dac_data_port_p2, .d = 0x0547}, // GPO VBAT_CON
  {.r = dac_data_port_p3, .d = 0x0547}, // GPO VBAT_EN
  {.r = dac_data_port_p7, .d = 0x0547}, // GPO SELFTEST
  {.r = dac_data_port_p8, .d = 0x0547}, // GPO LED GREEN
  {.r = dac_data_port_p9, .d = 0x0547}, // GPO LED YELLOW
  {.r = dac_data_port_p10,.d = 0x0547}, // GPO LED RED
  {.r = dac_data_port_p11,.d = 0x0547}, // GPO LED BLUE
  {.r = dac_data_port_p4, .d = 0x019a}, // DAC VBAT_ADJ
  {.r = dac_data_port_p5, .d = 0x019a}, // DAC HDR1 LDO ADJ
  {.r = dac_preset_data_1, .d = 0x0},
  {.r = dac_preset_data_2, .d = 0x0},
  {.r = gpo_data_P10P6_P5P0, .d = 0x0},
  {.r = gpo_data_P11, .d = 0x0},
  {.r = port_cfg_p2, .d = 0x3000},
  {.r = port_cfg_p3, .d = 0x3000},
  {.r = port_cfg_p7, .d = 0x3000},
  {.r = port_cfg_p8, .d = 0x3000},
  {.r = port_cfg_p9, .d = 0x3000},
  {.r = port_cfg_p10, .d = 0x3000},
  {.r = port_cfg_p11, .d = 0x3000},
  {.r = port_cfg_p4, .d = 0x5100},
  {.r = port_cfg_p5, .d = 0x5100},
  {.r = gpi_irqmode_P5_P0, .d = 0x0},
  {.r = gpi_irqmode_P10_P6, .d = 0x0},
  {.r = gpi_irqmode_P11, .d = 0x0},
  {.r = device_control, .d = 0xc0},
  {.r = interrupt_mask, .d = 0xffff},
};

/* init_max_iox
 * MAX11311 init register values come from the MAX11300 Configuration Tool (ver 1.1.0.5).
 * The Datasheet (DS) has a specific flowchart for how the registers are programmed,
 * and the time delay between writes. The tool generated sequence is used here.
 */
int init_max_iox(void) {
  char buf[LINE_MAX_LENGTH];

  max_iox.begin(SPI_MOSI_Pin, SPI_MISO_Pin, SPI_SCLK_Pin, SPI_CS_IOX_Pin, MAX11311_CONVERT_Pin);

  uint16_t _dev_id = max_iox.read_register(dev_id);
  if (_dev_id != MAX11311_DEV_ID) {
    snprintf(buf, LINE_MAX_LENGTH, "init_max_iox:id %x", _dev_id);
    oled_print(OLED_LINE_DEBUG, buf, true);
    return -1;
  }

  for (unsigned int i = 0; i < sizeof(init_regs) / sizeof(_init_regs_t); i++) {
    max_iox.write_register(init_regs[i].r, init_regs[i].d);
    delay(1);  // required by MAX11311 programming guide
  }
  return 0;
}

void iox_set(MAX11300::MAX11300_Ports port, bool assert) {
  max_iox.gpio_write(port, assert ? 1 : 0);
}

void iox_leds(bool green, bool yellow, bool red, bool blue) {
  iox_set(IOX_PORT_LED_GREEN, green);
  iox_set(IOX_PORT_LED_YELLOW, yellow);
  iox_set(IOX_PORT_LED_RED, red);
  iox_set(IOX_PORT_LED_BLUE, blue);
}

/* _iox_rpc
 * - common body of the active high IOX GPO RPCs
 */
static String _iox_rpc(const char *method, MAX11300::MAX11300_Ports port, bool assert) {
  JsonDocument &doc = rpc_begin(method);  // always first line of RPC API
  iox_set(port, assert);
  doc["result"]["assert"] = assert;
  doc["result"]["level"] = assert;
  return rpc_response(doc);  // always the last line of RPC API
}

String iox_vbat_con(bool assert) { return _iox_rpc(__func__, IOX_PORT_VBAT_CON, assert); }
String iox_vbat_en(bool assert) { return _iox_rpc(__func__, IOX_PORT_VBAT_EN, assert); }
String iox_selftest(bool assert) { return _iox_rpc(__func__, IOX_PORT_SELFTEST, assert); }
String iox_led_green(bool assert) { return _iox_rpc(__func__, IOX_PORT_LED_GREEN, assert); }
String iox_led_yellow(bool assert) { return _iox_rpc(__func__, IOX_PORT_LED_YELLOW, assert); }
String iox_led_red(bool assert) { return _iox_rpc(__func__, IOX_PORT_LED_RED, assert); }
String iox_led_blue(bool assert) { return _iox_rpc(__func__, IOX_PORT_LED_BLUE, assert); }

/* bond_ldo_set
 *  - Header 1 LDO output voltage, LDO_MIN_MV..LDO_MAX_MV, see bond_max_iox.h
 *  - the LDO is enabled by the Header 1 GPO on port 1
 */
String bond_ldo_set(uint16_t mv) {
  JsonDocument &doc = rpc_begin(__func__);  // always first line of RPC API
  if (mv < LDO_MIN_MV || mv > LDO_MAX_MV) return rpc_error(doc, "600 <= mv <= 3900, invalid parameter");

  // LDO_ADJ = 2 * VFB - (VOUT - VFB) * R47 / R46
  int32_t adj_mv = 2 * LDO_VFB_MV - ((int32_t)mv - LDO_VFB_MV) * LDO_R47_OHMS / LDO_R46_OHMS;
  uint16_t code = (uint16_t)((adj_mv * 4096 + IOX_DAC_FULL_MV / 2) / IOX_DAC_FULL_MV);
  max_iox.single_ended_dac_write(IOX_PORT_LDO_ADJ, code);

  doc["result"]["mv"] = mv;
  doc["result"]["dac_raw"] = code;
  return rpc_response(doc);  // always the last line of RPC API
}
